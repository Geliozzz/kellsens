## west.yml
```yaml
manifest:
  version: "0.10"

  remotes:
    - name: zephyr
      url-base: https://github.com/zephyrproject-rtos

  projects:
    - name: zephyr
      remote: zephyr
      revision: v4.3.0
      import: true

  self:
    path: kellsens
```
